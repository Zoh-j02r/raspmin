## conf/bblayers.conf
```bitbake
POKY_BBLAYERS_CONF_VERSION = "2"

BBPATH = "${TOPDIR}"
BBFILES ?= ""

BBLAYERS ?= " \
 /home/build/poky/meta \
 /home/build/poky/meta-poky \
 /home/build/poky/meta-yocto-bsp \
 /home/build/poky/meta-raspberrypi \
 /home/build/poky/meta-openrc \
 /home/build/poky/meta-raspmin \
 /home/build/poky/meta-openembedded/meta-multimedia \
 /home/build/poky/meta-openembedded/meta-oe \
 /home/build/poky/meta-openembedded/meta-python \
"
```

## conf/local.conf
```bitbake
MACHINE ??= "raspberrypi4-64"
DISTRO ?= "poky"
DISTRO_FEATURES += "openrc wifi rtc"
IMAGE_INSTALL:append = " vim bash sudo python3 kernel-modules"
PATCHRESOLVE = "noop"
SSTATE_DIR ?= "/home/build/share/sstate-cache"
DL_DIR ?= "/home/build/share/downloads"
TMPDIR = "/home/build/share/tmp"
IMAGE_FSTYPES = "ext4.xz rpi-sdimg"
SDIMG_ROOTFS_TYPE = "ext4.xz"
ENABLE_UART = "1"
CONF_VERSION = "2"
```

## image/conf/bblayers.conf
```bitbake
POKY_BBLAYERS_CONF_VERSION = "2"

BBPATH = "${TOPDIR}"
BBFILES ?= ""

BBLAYERS ?= " \
 /home/build/poky/meta \
 /home/build/poky/meta-poky \
 /home/build/poky/meta-yocto-bsp \
 /home/build/poky/meta-raspberrypi \
 /home/build/poky/meta-openrc \
 /home/build/poky/meta-raspmin \
"
```

## image/conf/local.conf
```bitbake
MACHINE ??= "raspberrypi4-64"
DISTRO ?= "poky"
DISTRO_FEATURES += "openrc wifi rtc"
EXTRA_IMAGE_FEATURES += "debug-tweaks"
IMAGE_INSTALL:append = " vim bash sudo python3 kernel-modules"
PATCHRESOLVE = "noop"
SSTATE_DIR ?= "/home/build/share/sstate-cache"
DL_DIR ?= "/home/build/share/downloads"
TMPDIR = "/home/build/share/tmp"
IMAGE_FSTYPES = "wic wic.bmap"
CONF_VERSION = "2"
```

## meta-raspmin/conf/layer.conf
```bitbake
# We have a conf and classes directory, append to BBPATH
BBPATH .= ":${LAYERDIR}"

# We have a recipes directory containing .bb and .bbappend files, add to BBFILES
BBFILES += "${LAYERDIR}/recipes*/*/*.bb \
            ${LAYERDIR}/recipes*/*/*.bbappend"

BBFILE_COLLECTIONS += "meta-raspmin"
BBFILE_PATTERN_meta-raspmin := "^${LAYERDIR}/"
BBFILE_PRIORITY_meta-raspmin = "5"

LAYERSERIES_COMPAT_meta-raspmin = "kirkstone"
LAYERDEPENDS_meta-raspmin = "core"
```
